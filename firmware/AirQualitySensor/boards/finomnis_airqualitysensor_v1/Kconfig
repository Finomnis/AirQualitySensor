## firmware/AirQualitySensor/boards/finomnis_airqualitysensor_v1/Kconfig
```kconfig
# Finomnis AirQualitySensor v1 board configuration

# Copyright (c) 2021 Martin Stumpf
# SPDX-License-Identifier: Apache-2.0

config BOARD_ENABLE_DCDC
	bool "Enable DCDC mode"
	select SOC_DCDC_NRF52X
	default y
	depends on BOARD_FINOMNIS_AIRQUALITYSENSOR_V1
```

## firmware/AirQualitySensor/boards/finomnis_airqualitysensor_v1/Kconfig.board
```kconfig
# Finomnis AirQualitySensor v1 board configuration

# Copyright (c) 2021 Martin Stumpf
# SPDX-License-Identifier: Apache-2.0

config BOARD_FINOMNIS_AIRQUALITYSENSOR_V1
	bool "Finomnis AirQualitySensor v1"
	depends on SOC_NRF52840_QIAA
```

## firmware/AirQualitySensor/boards/finomnis_airqualitysensor_v1/Kconfig.defconfig
```kconfig
# Finomnis AirQualitySensor v1 board configuration

# Copyright (c) 2021 Martin Stumpf
# SPDX-License-Identifier: Apache-2.0

if BOARD_FINOMNIS_AIRQUALITYSENSOR_V1

config BOARD
	default "finomnis_airqualitysensor_v1"

if USB

config USB_NRFX
	default y

config USB_DEVICE_STACK
	default y

endif # USB

config BT_CTLR
	default BT

endif # BOARD_FINOMNIS_AIRQUALITYSENSOR_V1
```

## firmware/AirQualitySensor/modules/boards/arm/finomnis_airqualitysensor_v1_nrf52840/Kconfig.defconfig
```kconfig
# Finomnis AirQualitySensor v1 board configuration

# Copyright (c) 2021 Martin Stumpf
# SPDX-License-Identifier: Apache-2.0

if BOARD_FINOMNIS_AIRQUALITYSENSOR_V1_NRF52840

config BOARD
	default "finomnis_airqualitysensor_v1_nrf52840"

if USB

config USB_NRFX
	default y

config USB_DEVICE_STACK
	default y

endif # USB

config BT_CTLR
	default BT

endif # BOARD_FINOMNIS_AIRQUALITYSENSOR_V1_NRF52840
```

## firmware/AirQualitySensor/modules/drivers/sensair_s8/Kconfig
```kconfig
# Sensair S8 Nano Power Real time Clock configuration options

menuconfig SENSAIR_S8
    bool "Sensair S8 CO2 Sensor"
    depends on (MODBUS && MODBUS_ROLE_CLIENT)
    help
      Enable Sensair S8 CO2 Sensor driver


# Workaround for not being able to have commas in macro arguments
DT_CHOSEN_Z_SENSAIR_S8_BUS := sensair,s8-bus

config SENSAIR_S8_MODBUS_DEV_NAME
	string "Device Name of Modbus Device for Sensair S8"
	default "$(dt_chosen_label,$(DT_CHOSEN_Z_SENSAIR_S8_BUS))" if HAS_DTS
	default "MODBUS_0"
	depends on SENSAIR_S8
	help
	  This option specifies the name of modbus device to be used
	  for Sensair S8.
```

## firmware/AirQualitySensor/modules/drivers/senseair_s8/Kconfig
```kconfig
# Senseair S8 Nano Power Real time Clock configuration options

menuconfig SENSEAIR_S8
    bool "Senseair S8 CO2 Sensor"
    depends on (MODBUS_SERIAL && MODBUS_ROLE_CLIENT)
    help
      Enable Senseair S8 CO2 Sensor driver


# Workaround for not being able to have commas in macro arguments
DT_CHOSEN_Z_SENSEAIR_S8_BUS := senseair,s8-bus

config SENSEAIR_S8_MODBUS_DEV_NAME
	string "Device Name of Modbus Device for Senseair S8"
	default "$(dt_chosen_label,$(DT_CHOSEN_Z_SENSEAIR_S8_BUS))" if HAS_DTS
	default "MODBUS_0"
	depends on SENSEAIR_S8
	help
	  This option specifies the name of modbus device to be used
	  for Senseair S8.
```

## firmware/AirQualitySensor/modules/subsys/Kconfig
```kconfig
comment "Subsystems"

rsource "dht22/Kconfig"
rsource "senseair_s8/Kconfig"
rsource "zigbee_device/Kconfig"
rsource "co2_leds/Kconfig"
rsource "display_dogm132w_5/Kconfig"
```

## firmware/AirQualitySensor/modules/subsys/co2_leds/Kconfig
```kconfig
menuconfig SUBSYS_CO2_LEDS
    bool "CO2 level status LEDs"
    help
      Enable status LEDs that visualize the room CO2 level

config SUBSYS_CO2_LEDS_STACK_SIZE
    int "CO2 LEDs thread stack size"
    depends on SUBSYS_CO2_LEDS
    default 512
    help
      Size of CO2 LEDs thread stack

config SUBSYS_CO2_LEDS_THREAD_PRIORITY
    int "CO2 LEDs thread priority"
    depends on SUBSYS_CO2_LEDS
    default 3
    help
      Priority of the CO2 LEDs thread.

config SUBSYS_CO2_LEDS_LEVEL_WARN_WEAK
    int "CO2 weak warning level"
    depends on SUBSYS_CO2_LEDS
    default 1000
    help
      The CO2 concentration above which a weak warning is shown, to indicate that
      it would be benefitial to open windows

config SUBSYS_CO2_LEDS_LEVEL_WARN_STRONG
    int "CO2 strong warning level"
    depends on SUBSYS_CO2_LEDS
    default 1500
    help
      The CO2 concentration above which a strong warning is shown, to indicate that
      windows should be opened if possible

config SUBSYS_CO2_LEDS_LEVEL_EXCELLENT
    int "CO2 excellent level"
    depends on SUBSYS_CO2_LEDS
    default 600
    help
      The CO2 concentration below which a an additional 'excellent' state is shown,
      to indicate that windows can be closed again
```

## firmware/AirQualitySensor/modules/subsys/dht22/Kconfig
```kconfig
menuconfig SUBSYS_DHT22
    bool "DHT22 sensor sampling subsystem"
    depends on DHT
    help
      Enable DHT22 thread that continuously samples DHT22 values.

config SUBSYS_DHT22_STACK_SIZE
    int "DHT22 thread stack size"
    depends on SUBSYS_DHT22
    default 512
    help
      Size of DHT22 thread stack

config SUBSYS_DHT22_THREAD_PRIORITY
    int "DHT22 thread priority"
    depends on SUBSYS_DHT22
    default -3
    help
      Priority of the DHT22 thread. Should be negative,
      as sensor reads might fail if preempted.

config SUBSYS_DHT22_SAMPLING_RATE_MS
    int "DHT22 sampling rate (ms)"
    depends on SUBSYS_DHT22
    default 2000
    range 2000 1000000000
    help
      The sampling rate of the sensor in milliseconds. Needs to be at least
      2000, as the sensor cannot sample faster.

config SUBSYS_DHT22_CALLBACK_MAX_COUNT_TEMPERATURE
    int "DHT22 max callbacks for temperature"
    depends on SUBSYS_DHT22
    default 10
    help
      Maximum number of temperature callbacks registered to the DHT22 device

config SUBSYS_DHT22_CALLBACK_MAX_COUNT_HUMIDITY
    int "DHT22 max callbacks for humidity"
    depends on SUBSYS_DHT22
    default 10
    help
      Maximum number of humidity callbacks registered to the DHT22 device
```

## firmware/AirQualitySensor/modules/subsys/display_dogm132w_5/Kconfig
```kconfig
menuconfig SUBSYS_DISPLAY_DOGM132W_5
    bool "Display DOGM132W-5"
    help
      Enables the DOGM132W-5 display that shows sensor values and system status

config SUBSYS_DISPLAY_DOGM132W_5_STACK_SIZE
    int "CO2 LEDs thread stack size"
    depends on SUBSYS_DISPLAY_DOGM132W_5
    default 512
    help
      Size of display thread stack

config SUBSYS_DISPLAY_DOGM132W_5_THREAD_PRIORITY
    int "CO2 LEDs thread priority"
    depends on SUBSYS_DISPLAY_DOGM132W_5
    default 4
    help
      Priority of the display thread.
```

## firmware/AirQualitySensor/modules/subsys/senseair_s8/Kconfig
```kconfig
menuconfig SUBSYS_SENSEAIR_S8
    bool "Senseair S8 sensor sampling subsystem"
    depends on SENSEAIR_S8
    help
      Enable Senseair S8 thread that continuously samples CO2 values.

config SUBSYS_SENSEAIR_S8_STACK_SIZE
    int "Senseair S8 thread stack size"
    depends on SUBSYS_SENSEAIR_S8
    default 512
    help
      Size of Senseair S8 thread stack

config SUBSYS_SENSEAIR_S8_THREAD_PRIORITY
    int "Senseair S8 thread priority"
    depends on SUBSYS_SENSEAIR_S8
    default 2
    help
      Priority of the Senseair S8 thread.

config SUBSYS_SENSEAIR_S8_SAMPLING_RATE_MS
    int "Senseair S8 sampling rate (ms)"
    depends on SUBSYS_SENSEAIR_S8
    default 4000
    range 4000 1000000000
    help
      The sampling rate of the sensor in milliseconds. Needs to be at least
      4000, as the sensor cannot sample faster.

config SUBSYS_SENSEAIR_S8_CALLBACK_MAX_COUNT_CO2
    int "Senseair S8 max callbacks for CO2"
    depends on SUBSYS_SENSEAIR_S8
    default 10
    help
      Maximum number of co2 callbacks registered to the Senseair S8 device
```

## firmware/AirQualitySensor/modules/subsys/zigbee_device/Kconfig
```kconfig
menuconfig SUBSYS_ZIGBEE_DEVICE
    bool "ZigBee device subsystem"
    depends on ZIGBEE
    depends on ZIGBEE_APP_UTILS
    help
      Enable ZigBee device that publishes sensor data to a ZigBee network.

config SUBSYS_ZIGBEE_DEVICE_STACK_SIZE
    int "ZigBee device thread stack size"
    depends on SUBSYS_ZIGBEE_DEVICE
    default 2048
    help
      Size of ZigBee device thread stack

config SUBSYS_ZIGBEE_DEVICE_THREAD_PRIORITY
    int "ZigBee device thread priority"
    depends on SUBSYS_ZIGBEE_DEVICE
    default 7
    help
      Priority of the ZigBee device thread

config SUBSYS_ZIGBEE_DEVICE_NETWORK_STATE_LED
    int "ZigBee device network state LED"
    depends on SUBSYS_ZIGBEE_DEVICE
    default 1
    help
      The LED number of the network status LED, as set in the device tree
```

## firmware/AirQualitySensor/subsys/dht22/Kconfig
```kconfig
config DHT22
    bool "DHT22 sensor sampling support"
    depends on DHT
    help
      Enable DHT22 thread that continuously samples DHT22 values.

config DHT22_STACK_SIZE
    int "DHT22 thread stack size"
    depends on DHT22
    default 500
    help
      Size of DHT22 thread stack

config DHT22_THREAD_PRIORITY
    int "DHT22 thread priority"
    depends on DHT22
    default -3
    help
      Priority of the DHT22 thread. Should be negative,
      as sensor reads might fail if preempted.

config DHT22_SAMPLING_RATE_MS
    int "DHT22 sampling rate (ms)"
    depends on DHT22
    default 2000
    range 2000 1000000000
    help
      The sampling rate of the sensor in milliseconds. Needs to be at least
      2000, as the sensor cannot sample faster.
```
